## boards/shields/fusen/Kconfig.defconfig
```kconfig
if SHIELD_FUSEN_LEFT

config ZMK_KEYBOARD_NAME
    default "Fusen"

config ZMK_SPLIT
    default y

config INPUT
    default y

config ZMK_SPLIT_ROLE_CENTRAL
    default y

endif

if SHIELD_FUSEN_RIGHT

config ZMK_KEYBOARD_NAME
    default "Fusen_R"

config ZMK_SPLIT
    default y

config INPUT
    default y

endif
```

## boards/shields/fusen/Kconfig.shield
```kconfig
config SHIELD_FUSEN_LEFT
    def_bool $(shields_list_contains,fusen_left)

config SHIELD_FUSEN_RIGHT
    def_bool $(shields_list_contains,fusen_right)
```
