#include "fusen.dtsi"

&xiao_serial { status = "disabled"; };

&kscan0 {
    row-gpios
        = <&xiao_d X (GPIO_ACTIVE_HIGH | GPIO_PULL_DOWN)> 
        , <&xiao_d X (GPIO_ACTIVE_HIGH | GPIO_PULL_DOWN)> 
        , <&xiao_d X (GPIO_ACTIVE_HIGH | GPIO_PULL_DOWN)> 		
        ;  
    col-gpios
        = <&xiao_d X GPIO_ACTIVE_HIGH>
        , <&xiao_d X GPIO_ACTIVE_HIGH>
        , <&xiao_d X GPIO_ACTIVE_HIGH>
        ;
};