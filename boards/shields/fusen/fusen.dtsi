#include <dt-bindings/zmk/matrix_transform.h>
#include <input/processors.dtsi>
#include <dt-bindings/zmk/input_transform.h>

/ {
    chosen {
        zmk,kscan = &kscan0;
        zmk,matrix_transform = &default_transform;
    };

    default_transform: keymap_transform_0 {
        compatible = "zmk,matrix-transform";
        columns = <6>;
        rows = <3>;
        map = <
                RC(,)   RC(,)   RC(,)   RC(,)   RC(,)   RC(,)
        RC(,)   RC(,)   RC(,)   RC(,)   RC(,)   RC(,)   RC(,)   RC(,)
                        RC(,)   RC(,)   RC(,)   RC(,)
        >;
    };

    kscan0: kscan {
        compatible ="zmk,kscan-gpio-matrix";
        label = "KSCAN";
        diode-direction = "col2row";

    };
};